## config/boards/shields/Kconfig.defconfig
```kconfig
if SHIELD_THUMBOY

config ZMK_KEYBOARD_NAME
    default "thumboy"

config ZMK_SPLIT_ROLE_CENTRAL
    default y

endif

if SHIELD_THUMBOY_LEFT || SHIELD_THUMBOY_RIGHT

    config ZMK_SPLIT
        default y

endif
```

## config/boards/shields/Kconfig.shield
```kconfig
config SHIELD_THUMBOY_LEFT
    def_bool $(shields_list_contains, thumboy_left)

config SHIELD_THUMBOY_RIGHT
    def_bool $(shields_list_contains, thumboy_right)
```
